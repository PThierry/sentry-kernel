## kernel/src/startup/Kconfig
```kconfig
# SPDX-FileCopyrightText: 2023-2024 Ledger SAS
# SPDX-License-Identifier: Apache-2.0

menu "Core functions"

config MAX_TASKS
	int "Maximum number of userspace tasks"
	range 1 256
	default 8
	help
	  Maximum number of userspace tasks, from 1 to 256


choice
	bool "Scheduling policy"
	default SCHED_RRMQ
config SCHED_RRMQ
	bool "Round-Robin Multiqueue with Quantum scheduler policy"
	help
	  Schedule task with multiqueue round-robin, with elastic quantum support
	  Allows differenciated quantum per task, with timeslotting-based task sets
	  Highly efficient when well configured.
	  A task can yield() before its quantum end to refresh it. Blocking syscalls
	  (IPC, sleep) also refresh the quantum.
config SCHED_FIFO
	bool "FIFO-based policy"
	help
	  Schedule task with FIFO scheduling policy. Each task is executed
	  while not entering a blocking syscall (yield, sleep, etc.). The
	  task is eligible again each time an input event is received (IPC, signal,
	  interrupt)
config SCHED_RMA
	bool "Rate Monotonic Algorithm scheduler policy (EXPERIMENTAL)"
	help
	  Schedule tasks using the Rate Monotonic Algorithm (RMA), a fixed-priority
	  preemptive policy optimal for independent periodic task sets.
	  The task period is taken from the priority field of the task metadata:
	  a smaller value means a shorter period and therefore a higher scheduling
	  priority.  The quantum field is not used.
	  Tasks are re-activated at each period boundary; a task that blocks
	  (sleep, IPC wait, …) exits the ready set and is re-admitted only when
	  explicitly re-scheduled at wakeup time.

endchoice

config SCHED_TDM
	bool "Enable TDM domain scheduling layer"
	help
	  Enable a top-level Time Division Multiplexing (TDM) scheduler that
	  allocates one dedicated time window per task domain.
	  The selected scheduling policy above remains the intra-domain policy
	  (FIFO, RRMQ or RMA).

config SCHED_TDM_WINDOW_TICKS
	int "TDM shared time window duration (ticks)"
	depends on SCHED_TDM
	range 1 1000000
	default 10
	help
	  Duration, in system ticks, of a TDM slot.
	  This single value is shared by all domains.

config SCHED_NAME
	string
	default "TDM+RRMQ" if SCHED_TDM && SCHED_RRMQ
	default "TDM+FIFO" if SCHED_TDM && SCHED_FIFO
	default "TDM+RMA"  if SCHED_TDM && SCHED_RMA
	default "RRMQ" if !SCHED_TDM && SCHED_RRMQ
	default "FIFO" if !SCHED_TDM && SCHED_FIFO
	default "RMA"  if !SCHED_TDM && SCHED_RMA

endmenu
```
